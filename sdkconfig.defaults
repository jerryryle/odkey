## sdkconfig.defaults
```kconfig
# Flash Configuration
CONFIG_ESPTOOLPY_FLASHSIZE_4MB=y

# USB Device Configuration
CONFIG_USB_DEVICE_ENABLED=y
CONFIG_TINYUSB_MODE_SLAVE=y
CONFIG_TINYUSB_HID_COUNT=2

# USB Descriptor Configuration
CONFIG_TINYUSB_DESC_USE_ESPRESSIF_VID=y
CONFIG_TINYUSB_DESC_USE_DEFAULT_PID=y
CONFIG_TINYUSB_DESC_BCD_DEVICE=0x0100
CONFIG_TINYUSB_DESC_MANUFACTURER_STRING="ODKey"
CONFIG_TINYUSB_DESC_PRODUCT_STRING="USB Keyboard"
CONFIG_TINYUSB_DESC_SERIAL_STRING="123456"

# USB OTG Configuration
CONFIG_USB_OTG_SUPPORTED=y
CONFIG_USB_OTG_NUM=0

# USB Serial Configuration
CONFIG_ESP_ROM_USB_SERIAL_DEVICE_NUM=0

# WiFi Configuration
CONFIG_ESP_WIFI_ENABLED=y
CONFIG_ESP_WIFI_SOFTAP_SUPPORT=y
CONFIG_ESP_WIFI_STA_DISCONNECTED_PM_ENABLE=y

# HTTP Server Configuration
CONFIG_HTTPD_MAX_REQ_HDR_LEN=512
CONFIG_HTTPD_MAX_URI_LEN=512
```
